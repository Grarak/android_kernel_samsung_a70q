## arch/arm64/Kconfig.sec
```kconfig
config SEC_A60Q_PROJECT
        depends on ARCH_SM6150
        default n
        bool "Samsung A60Q Project"
        help
          Support for Samsung A60Q Project

config SEC_A60Q_CHN_PROJECT
        depends on SEC_A60Q_PROJECT
        default n
        bool "Samsung A60Q CHN OPEN Project"
        help
          Support for Samsung A60Q CHN OPEN Project
		  
config SEC_A60Q_SWA_PROJECT
        depends on SEC_A60Q_PROJECT
        default n
        bool "Samsung A60Q SWA OPEN Project"
        help
          Support for Samsung A60Q SWA OPEN Project

config SEC_A70Q_PROJECT
        depends on ARCH_SM6150
        default n
        bool "Samsung A70Q Project"
        help
          Support for Samsung A70Q Project

config SEC_A70Q_EUR_PROJECT
        depends on SEC_A70Q_PROJECT
        default n
        bool "Samsung A70Q EUR OPEN Project"
        help
          Support for Samsung A70Q EUR OPEN Project
		  
config SEC_A70Q_EUR_LDU_PROJECT
        depends on SEC_A70Q_PROJECT
        default n
        bool "Samsung A70Q EUR LDU Project"
        help
          Support for Samsung A70Q EUR LDU Project

config SEC_A70Q_USA_PROJECT
        depends on SEC_A70Q_PROJECT
        default n
        bool "Samsung A70Q USA SINGLE Project"
        help
          Support for Samsung A70Q USA SINGLE Project

config SEC_A70Q_KOR_PROJECT
        depends on SEC_A70Q_PROJECT
        default n
        bool "Samsung A70Q KOR SINGLE Project"
        help
          Support for Samsung A70Q KOR SINGLE Project
		  
config SEC_A70Q_CHN_PROJECT
        depends on SEC_A70Q_PROJECT
        default n
        bool "Samsung A70Q CHN OPEN Project"
        help
          Support for Samsung A70Q CHN OPEN Project
		  
config SEC_A70Q_SEA_OPEN_PROJECT
        depends on SEC_A70Q_PROJECT
        default n
        bool "Samsung A70Q SEA OPEN Project"
        help
          Support for Samsung A70Q SEA OPEN Project
		  
config SEC_A70Q_SEA_XTC_PROJECT
        depends on SEC_A70Q_PROJECT
        default n
        bool "Samsung A70Q SEA XTC Project"
        help
          Support for Samsung A70Q SEA XTC Project
		  
config SEC_A70Q_SEA_XSA_PROJECT
        depends on SEC_A70Q_PROJECT
        default n
        bool "Samsung A70Q SEA XSA Project"
        help
          Support for Samsung A70Q SEA XSA Project
		 
config SEC_A70Q_CAN_PROJECT
		depends on SEC_A70Q_PROJECT
        default n
        bool "Samsung A70Q CAN SINGLE Project"
        help
          Support for Samsung A70Q CAN SINGLE Project
		  
config SEC_A70Q_SWA_PROJECT
        depends on SEC_A70Q_PROJECT
        default n
        bool "Samsung A70Q SWA OPEN Project"
        help
          Support for Samsung A70Q SWA OPEN Project

config SEC_R1Q_PROJECT
        depends on ARCH_SM6150
        default n
        bool "Samsung R1Q Project"
        help
          Support for Samsung R1Q Project

config SEC_R1Q_EUR_PROJECT
        depends on SEC_R1Q_PROJECT
        default n
        bool "Samsung R1Q EUR OPEN Project"
        help
          Support for Samsung A90Q EUR OPEN Project

config SEC_R1Q_EUR_LDU_PROJECT
        depends on SEC_R1Q_PROJECT
        default n
        bool "Samsung R1Q EUR LDU Project"
        help
          Support for Samsung R1Q EUR LDU Project

config SEC_R1Q_CHN_PROJECT
        depends on SEC_R1Q_PROJECT
        default n
        bool "Samsung R1Q CHN OPEN Project"
        help
          Support for Samsung R1Q CHN OPEN Project

config SEC_R1Q_CHN_LDU_PROJECT
        depends on SEC_R1Q_PROJECT
        default n
        bool "Samsung R1Q CHN LDU Project"
        help
          Support for Samsung R1Q CHN LDU Project

config SEC_R1Q_KOR_PROJECT
        depends on SEC_R1Q_PROJECT
        default n
        bool "Samsung A90Q KOR SINGLE Project"
        help
          Support for Samsung R1Q KOR SINGLE Project

config SEC_A90Q_PROJECT
        depends on ARCH_SM6150
	select SEC_R1Q_PROJECT
        default n
        bool "Samsung A90Q Project"
        help
          Support for Samsung A90Q Project

config SEC_A90Q_EUR_PROJECT
        depends on SEC_A90Q_PROJECT
	select SEC_R1Q_EUR_PROJECT
        default n
        bool "Samsung A90Q EUR OPEN Project"
        help
          Support for Samsung A90Q EUR OPEN Project

config SEC_A90Q_EUR_LDU_PROJECT
        depends on SEC_A90Q_PROJECT
	select SEC_R1Q_EUR_LDU_PROJECT
        default n
        bool "Samsung A90Q EUR LDU Project"
        help
          Support for Samsung A90Q EUR LDU Project

config SEC_A90Q_CHN_PROJECT
        depends on SEC_A90Q_PROJECT
	select SEC_R1Q_CHN_PROJECT
        default n
        bool "Samsung A90Q CHN OPEN Project"
        help
          Support for Samsung A90Q CHN OPEN Project

config SEC_A90Q_CHN_LDU_PROJECT
        depends on SEC_A90Q_PROJECT
	select SEC_R1Q_CHN_LDU_PROJECT
        default n
        bool "Samsung A90Q CHN LDU Project"
        help
          Support for Samsung A90Q CHN LDU Project

config SEC_A90Q_KOR_PROJECT
        depends on SEC_A90Q_PROJECT
	select SEC_R1Q_KOR_PROJECT
        default n
        bool "Samsung A90Q KOR SINGLE Project"
        help
          Support for Samsung A90Q KOR SINGLE Project
```

## drivers/adsp_factory/Kconfig
```kconfig
#
# factory sensor drivers configuration
#
config ADSP_FACTORY
	tristate "MSM ADSP factory driver"
	default n
	help
	  This driver communicate with SSC DAEMON.
	  register each sensor device.
	  send selftest request using netlink.
	  receive test result using netlink.

config LSM6DSM_FACTORY
	tristate "factory test for SSC - LSM6DSM"
	default n
	help
	  lsm6dsm factory driver.
	  provide sysfs for factory test.
	  request selftest to adsp_factory.
	  receive test result from adsp_factory.

config TCS3701_FACTORY
	tristate "factory test for SSC - TCS3701"
	default n
	help
	  tcs3701 factory driver.
	  provide sysfs for factory test.
	  request selftest to adsp_factory.
	  receive test result from adsp_factory.

config SUPPORT_BHL_COMPENSATION_FOR_LIGHT_SENSOR
	tristate "Sensors support BHL compensation"
	default n
	help
	  Support BHL compensation for light sensor
	  provide sysfs for LCD service.
	  receive aor and brightness level from lcd driver.

config YAS539_FACTORY
	tristate "factory test for SSC - YAS539"
	default n
	help
	  yas539 factory driver.
	  provide sysfs for factory test.
	  request selftest to adsp_factory.
	  receive test result from adsp_factory.

config STK3331_FACTORY
	tristate "factory test for SSC - STK3331"
	default n
	help
	  stk3331 factory driver.
	  provide sysfs for factory test.
	  request selftest to adsp_factory.
	  receive test result from adsp_factory.

config AK09918_FACTORY
	tristate "factory test for SSC - AK09918"
	default n
	help
	  ak09918 factory driver.
	  provide sysfs for factory test.
	  request selftest to adsp_factory.
	  receive test result from adsp_factory.

config GP2AP110S_FACTORY
	tristate "factory test for SSC - GP2AP110S"
	default n
	help
	  gp2ap110s factory driver.
	  provide sysfs for factory test.
	  request selftest to adsp_factory.
	  receive test result from adsp_factory.

config SUPPORT_SSC_MODE
	tristate "Support ssc mode function for adsp sensor"
	default n
	depends on ADSP_FACTORY
	help
	  Support the ssc mode function.

config SUPPORT_SSC_MODE_FOR_MAG
	tristate "Support ssc mode for mag function for mag sensor"
	default n
	depends on ADSP_FACTORY
	help
	  Support the ssc mode for mag function.
```

## drivers/media/platform/msm/camera/Kconfig
```kconfig
config SAMSUNG_OIS_MCU_STM32
        tristate "External ois MCU STM32 support"
	depends on SPECTRA_CAMERA
	default n
	---help---
	Enables support for external ois module.

config SAMSUNG_APERTURE
        tristate "External aperture support"
	depends on SPECTRA_CAMERA
	default n
	---help---
	Enables support for external aperture module.

config SAMSUNG_APERTURE_HALLTEST
        tristate "aperture hall test support"
	depends on SPECTRA_CAMERA
	default n
	---help---
	Enables support for aperture hall est

config SAMSUNG_REAR_DUAL
	tristate "Rear dual camera support"
	depends on SPECTRA_CAMERA
	default n
	---help---
	Enables support for rear dual camera.

config SAMSUNG_REAR_TRIPLE
	tristate "Rear triple camera support"
	depends on SPECTRA_CAMERA
	default n
	---help---
	Enables support for rear triple camera.

config SAMSUNG_FRONT_DUAL
	tristate "Front dual camera support"
	depends on SPECTRA_CAMERA
	default n
	---help---
	Enables support for front dual camera.

config SAMSUNG_FRONT_TOF
	tristate "Front tof camera support"
	depends on SPECTRA_CAMERA
	default n
	---help---
	Enables support for front tof camera.

config SAMSUNG_REAR_TOF
	tristate "rear tof camera support"
	depends on SPECTRA_CAMERA
	default n
	---help---
	Enables support for rear tof camera.

config CAMERA_SYSFS_V2
	bool "CAMERA SYS"
	depends on SPECTRA_CAMERA
	---help---
	Enable support CAMERA SYS.

config SAMSUNG_FRONT_EEPROM
	tristate "Front eeprom support"
	depends on SPECTRA_CAMERA
	default n
	---help---
	Enables support for front eeprom

config SAMSUNG_SECURE_CAMERA
	tristate "Secure camera support"
	depends on SPECTRA_CAMERA
	default n
	---help---
	Enables support for secure camera

config CAMERA_DYNAMIC_MIPI
	tristate "Multi camera support"
	depends on SPECTRA_CAMERA
	default n
	---help---
	Enables support for dynamic mipi clock

config CAMERA_FRS_DRAM_TEST
	tristate "Camera dram support"
	depends on SPECTRA_CAMERA
	default n
	---help---
	Enables support for DRAM test

config USE_CAMERA_HW_BIG_DATA
	bool "CAMERA HW SYS"
	depends on SPECTRA_CAMERA
	default n
	---help---
	CAMERA HW SYS.

config FLASH_CURRENT_JAPAN
	tristate "flash current for jpn"
	depends on SPECTRA_CAMERA
	default n
	---help---
	Enables support for JPN

config CAMERA_SSM_I2C_ENV
	tristate "Rear camera support"
	depends on SPECTRA_CAMERA
	default n
	---help---
	Enables support for SSM I2C test

config SAMSUNG_MULTI_CAMERA
	tristate "Multi camera support"
	depends on SPECTRA_CAMERA
	default n
	---help---
	Enables support for multi camera.

config GC5035_SENSOR
	tristate "Sensor gc5035 support"
	depends on SPECTRA_CAMERA
	default n
	---help---
	Enables support for SENSOR

config SAMSUNG_CAMERA_OTP
	tristate "Sensor OTP support"
	depends on SPECTRA_CAMERA
	default n
	---help---
	Enables support for SENSOR OTP
```
